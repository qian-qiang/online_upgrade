/**
  ******************************************************************************
  * @file    drv_packer.c
  * @author  zpw
  * @version V1.0
  * @date    
  * @brief   链路层通讯协议
  ******************************************************************************
  * @attention
  *          链路层通讯协议，数据封包解包
  ******************************************************************************
  */
#define LOG_TAG      "uart.upk"
#define LOG_LVL      LOG_LVL_DBG 
  
#include "upacker.h"
#include "ulog.h"
#include "protocol_id.h"

static uint8_t frame_decode(upacker_inst_t packer, uint8_t d);
static uint8_t frame_encode(upacker_inst_t packer, uint8_t *data, uint16_t size);

const uint8_t auch_crc_hi[]=  
{  
0x00, 0xC1, 0x81, 0x40, 0x01, 0xC0, 0x80, 0x41, 0x01, 0xC0, 0x80, 0x41, 0x00, 0xC1, 0x81,  
0x40, 0x01, 0xC0, 0x80, 0x41, 0x00, 0xC1, 0x81, 0x40, 0x00, 0xC1, 0x81, 0x40, 0x01, 0xC0,  
0x80, 0x41, 0x01, 0xC0, 0x80, 0x41, 0x00, 0xC1, 0x81, 0x40, 0x00, 0xC1, 0x81, 0x40, 0x01,  
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0x00, 0xC1, 0x81, 0x40, 0x01, 0xC0, 0x80, 0x41, 0x01, 0xC0, 0x80, 0x41, 0x00, 0xC1, 0x81,  
0x40  
};  
  
const uint8_t auch_crc_lo[] =  
{  
0x00, 0xC0, 0xC1, 0x01, 0xC3, 0x03, 0x02, 0xC2, 0xC6, 0x06, 0x07, 0xC7, 0x05, 0xC5, 0xC4,  
0x04, 0xCC, 0x0C, 0x0D, 0xCD, 0x0F, 0xCF, 0xCE, 0x0E, 0x0A, 0xCA, 0xCB, 0x0B, 0xC9, 0x09,  
0x08, 0xC8, 0xD8, 0x18, 0x19, 0xD9, 0x1B, 0xDB, 0xDA, 0x1A, 0x1E, 0xDE, 0xDF, 0x1F, 0xDD,  
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0x44, 0x84, 0x85, 0x45, 0x87, 0x47, 0x46, 0x86, 0x82, 0x42, 0x43, 0x83, 0x41, 0x81, 0x80,  
0x40  
};  

uint8_t crc_16(uint8_t *buf, uint16_t len)
{
//	uint8_t crc_hi=0xff;  
//	uint8_t crc_lo=0xff;  
//	uint16_t index;  
//	uint16_t value;
//	while(len--)  
//	{  
//		index = crc_hi ^* buf++;  
//		crc_hi = crc_lo ^ auch_crc_hi[index];  
//		crc_lo = auch_crc_lo[index];  
//	}  
//	value = crc_hi;
//	value <<= 8;
//	value |= crc_lo;
//	
//    return value; 
    
    	uint8_t tmp=0xff;
		tmp=tmp^buf[0];
		tmp=tmp^buf[1];
		tmp=tmp^buf[2];
		tmp=tmp^buf[3];
		tmp=tmp^buf[4];
		tmp=tmp^buf[5];
		tmp=tmp^buf[6];
		tmp=tmp^0xa2;
		return tmp;
}

/**
 * @brief  使用动态内存时需要初始化
 * @note   size pack缓存的长度，大于最大的数据包长度就行,使用PACK_SIZE
            无rtos最好用静态内存,不然要改heap
 * @param  *cmd_packer: 
 * @param  *handler: 
 * @retval None
 */
int upacker_init(char* name, upacker_inst_t packer, PACKER_CB h, PACKER_CB s)
{

#if USE_DYNAMIC_MEM
    packer->data = (uint8_t *)UP_MALLOC(MAX_PACK_SIZE);
    if (!packer->data)
    {
        return -1;
    }
#endif

    packer->cb = h;
    packer->send = s;

    packer->sem_pack = rt_sem_create(name, 1, RT_IPC_FLAG_PRIO);
    
    return 0;
}

/**
 * @brief  解包输入数据
 * @note   
 * @param  cmd_packer: 
 * @param  *buff: 
 * @param  size: 
 * @retval None
 */
void upacker_unpack(upacker_inst_t packer, uint8_t *buff, uint16_t size)
{
    for (uint16_t i = 0; i < size; i++)
    {
        if (frame_decode(packer, buff[i]))
        {
            //解析成功,回调处理
            packer->cb(packer->data, packer->flen);
        }
    }
}

/**
 * @brief  封包数据并发送
 * @note   
 * @param  *packer: 
 * @param  *buff: 
 * @param  size: 
 * @retval None
 */
void upacker_pack(upacker_inst_t packer, uint8_t *buff, uint16_t size)
{
    RT_ASSERT(packer->sem_pack != RT_NULL);
    
    rt_sem_take(packer->sem_pack,RT_WAITING_FOREVER);
    frame_encode(packer, buff, size);
    rt_sem_release(packer->sem_pack);
}

static uint8_t frame_decode(upacker_inst_t packer, uint8_t d)
{
    //注意包断掉接续  
	//注意一包数据不完整新包又来临
	 
	if(d == STX_L)
	{
		packer->head_flag = 1;
	}
	else if(packer->head_flag && (d == STX_R))
	{
		packer->head_flag = 2;
		return 0;
        
	}else if((packer->head_flag ==2) && (d == STX_F))
	{
		packer->head_flag = 0;
		packer->state = 1;
		packer->cnt = 0;
        packer->flen = 8;
		return 0;
	}
	else
	{
		packer->head_flag = 0;
	}
	
    if (packer->state == 1)
    {
        packer->data[packer->cnt++] = d;
        
        if (packer->cnt == packer->flen)
        {
			packer->flen -= 2;
		
			packer->check = packer->data[packer->flen + 1];

			//校验
			packer->calc = crc_16(packer->data, packer->flen);
			packer->state = 0;
			
			//接收完，检查check
			if ((packer->calc) == (packer->check))
			{
				return 1;
			}
			else
			{
				log_e("crc check error %x for %x", packer->calc, packer->check);
				return 0;
			}
        }
    }
    else
    {
        packer->state = 0;
    }
    return 0;
}

static uint8_t frame_encode(upacker_inst_t packer, uint8_t *data, uint16_t size)
{
	uint8_t len = 0;
    uint8_t tmp[MAX_PACK_SIZE] = {0};
    uint8_t crc = 0;

    if (size > 16384)
    {
        return 0;
    }

    for (int i = 0; i < size; i++)
    {
        tmp[i] = data[i];
    }
    
    len += size;
	crc = crc_16(&tmp[3], ++size);

	tmp[len] = 0; 
    tmp[len + 1] = crc & 0xff;  
	
	len += 2;
	
    packer->send(tmp, len);

    return 1;
}
